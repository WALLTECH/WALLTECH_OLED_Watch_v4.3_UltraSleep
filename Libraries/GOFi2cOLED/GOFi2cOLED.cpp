/*
  GOFi2cOLED.h - SSD1306 OLED Driver Library
  2012 Copyright (c) GOF Electronics Co. Ltd.  All right reserved.
 
  Original Author: Limor Fried/Ladyada��Adafruit Industries��
  Modified by: Jimbo.we(www.geekonfire.com)
  
  GeekOnFire invests time and resources providing this open source code, 
	please support GeekOnFire and open-source hardware by purchasing 
	products from GeekOnFire!
	
  This library is derived from Adafruit_GFX library, only for SSD1306 in I2C Mode.
  It is a free software; you can redistribute it and/or modify it 
  under the terms of BSD license, check license.txt for more information.
	All text above must be included in any redistribution.
*/

#include <avr/pgmspace.h>
#include <util/delay.h>
#include <stdlib.h>

#include "Wire.h"
#include "GOFi2cOLED.h"

// a 5x7 font table
const unsigned char  BasicFont[] PROGMEM = {
  0x00, 0x00, 0x00, 0x00, 0x00,   
	0x3E, 0x5B, 0x4F, 0x5B, 0x3E, 	
	0x3E, 0x6B, 0x4F, 0x6B, 0x3E, 	
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	0x00, 0x00, 0x00, 0x00, 0x00, 
};

//init GOF logo in buffer��this buffer map to the GDDRAM of SSD1306��
static uint8_t buffer[128 * 64 / 8] = {
0x00, 0x00, 0x00, 0x00, 0x00, 0x00, 0x00, 0x00, 0x00, 0x00, 0x00, 0x00, 0x00, 0x00, 0x00, 0x00,
0x00, 0x00, 0x00, 0x00, 0x00, 0x00, 0x00, 0x00, 0x00, 0x00, 0x00, 0x00, 0x00, 0x00, 0x08, 0xF8,
0xF8, 0xF0, 0xF0, 0xE0, 0x80, 0x00, 0x00, 0x00, 0x00, 0x00, 0x00, 0x00, 0x00, 0x00, 0x00, 0x00,
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0x00, 0x00, 0x00, 0x00, 0x00, 0x00, 0x00, 0x00, 0x00, 0x00, 0x00, 0x00, 0x00, 0x00, 0x00, 0x00
};


void GOFi2cOLED::init(uint8_t address)
{
 delay(5);	//wait for OLED hardware init
 constructor(128, 64);
 SlaveAddress = address;

 sendCommand(GOFi2cOLED_Display_Off_Cmd);    /*display off*/

 sendCommand(Set_Multiplex_Ratio_Cmd);    /*multiplex ratio*/
 sendCommand(0x3F);    /*duty = 1/64*/

 sendCommand(Set_Display_Offset_Cmd);    /*set display offset*/
 sendCommand(0x00);


 sendCommand(0xB0); 			//set page address
 sendCommand(0x00); 	//set column lower address
 sendCommand(0x10); 	//set column higher address

 setHorizontalMode();        /*set Page Addressing Mode*/

 sendCommand(0x40);    /*set display starconstructort line*/

 sendCommand(Set_Contrast_Cmd);    /*contract control*/
 sendCommand(0xcf);    /*128*/

 sendCommand(Segment_Remap_Cmd);    /*set segment remap*/

 sendCommand(COM_Output_Remap_Scan_Cmd);    /*Com scan direction*/

 sendCommand(GOFi2cOLED_Normal_Display_Cmd);    /*normal / reverse*/

 sendCommand(Set_Display_Clock_Divide_Ratio_Cmd);    /*set osc division*/
 sendCommand(0x80);

 sendCommand(Set_Precharge_Period_Cmd);    /*set pre-charge period*/
 sendCommand(0xf1);

 sendCommand(Set_COM_Pins_Hardware_Config_Cmd);    /*set COM pins*/
 sendCommand(0x12);

 sendCommand(Set_VCOMH_Deselect_Level_Cmd);    /*set vcomh*/
 sendCommand(0x30);

 sendCommand(Deactivate_Scroll_Cmd);

 sendCommand(Charge_Pump_Setting_Cmd);    /*set charge pump enable*/
 sendCommand(Charge_Pump_Enable_Cmd);

 sendCommand(GOFi2cOLED_Display_On_Cmd);    /*display ON*/
}

void GOFi2cOLED::constructor(uint8_t w, uint8_t h) {
  _width = WIDTH = w;
  _height = HEIGHT = h;

  rotation = 0;    
  cursor_y = cursor_x = 0;
  textsize = 1;
  textcolor = textbgcolor = WHITE;  
  wrap = true;
}

// the most basic function, set a single pixel
void GOFi2cOLED::drawPixel(uint8_t x, uint8_t y, uint8_t color) {
  if ((x < 0) || (x >= width()) || (y < 0) || (y >= height()))
    return;

  // check rotation, move pixel around if necessary
  switch (getRotation()) {
  case 1:
    swap(x, y);
    x = WIDTH - x - 1;
    break;
  case 2:
    x = WIDTH - x - 1;
    y = HEIGHT - y - 1;
    break;
  case 3:
    swap(x, y);
    y = HEIGHT - y - 1;
    break;
  }  
  // x is which column
  if (color == WHITE) 
    buffer[x+ (y/8)*128] |= _BV((y%8));  
  else
    buffer[x+ (y/8)*128] &= ~_BV((y%8)); 
}

void GOFi2cOLED::sendCommand(unsigned char command)
{
  Wire.begin();                       //initialize I2C
  Wire.beginTransmission(SlaveAddress); // begin I2C communication
#if defined(ARDUINO) && ARDUINO >= 100
  Wire.write(GOFi2cOLED_Command_Mode);	     // Set OLED Command mode
  Wire.write(command);
#else
  Wire.send(GOFi2cOLED_Command_Mode);	     // Set OLED Command mode
  Wire.send(command);
#endif
  Wire.endTransmission();    		     // End I2C communication
}

void GOFi2cOLED::sendData(unsigned char Data)
{
  Wire.begin();                    //initialize I2C
  Wire.beginTransmission(SlaveAddress); // begin I2C transmission
#if defined(ARDUINO) && ARDUINO >= 100
  Wire.write(GOFi2cOLED_Data_Mode);            // data mode
  Wire.write(Data);
#else
  Wire.send(GOFi2cOLED_Data_Mode);            // data mode
  Wire.send(Data);
#endif
  Wire.endTransmission();                    // stop I2C transmission
}

void GOFi2cOLED::setBrightness(unsigned char Brightness)
{
   sendCommand(Set_Contrast_Cmd);
   sendCommand(Brightness);
}

void GOFi2cOLED::setHorizontalMode()
{
    sendCommand(Set_Memory_Addressing_Mode_Cmd); 	//set addressing mode
    sendCommand(HORIZONTAL_MODE); 			//set horizontal addressing mode
}

void GOFi2cOLED::setVerticalMode()
{
    sendCommand(Set_Memory_Addressing_Mode_Cmd); 	//set addressing mode
    sendCommand(VERTICAL_MODE); 			//set horizontal addressing mode
}

void GOFi2cOLED::setPageMode()
{
    sendCommand(Set_Memory_Addressing_Mode_Cmd); 	//set addressing mode
    sendCommand(PAGE_MODE); 			        //set page addressing mode
}

void GOFi2cOLED::display(void) {
  sendCommand(0x00 | 0x0);  // low col = 0
  sendCommand(0x10 | 0x0);  // hi col = 0
  sendCommand(0x40 | 0x0); // line #0

    // save I2C bitrate
//    uint8_t twbrbackup = TWBR;
//    TWBR = 12; // upgrade to 400KHz!

    // I2C
    #if defined(ARDUINO) && ARDUINO >= 100
    for (uint16_t i=0; i<(128*64/8); i++) 
    {
      // send a bunch of data in one xmission
      Wire.beginTransmission(SlaveAddress);
      Wire.write(GOFi2cOLED_Data_Mode);            // data mode
      for (uint8_t x=0; x<16; x++) 
      {
        Wire.write(buffer[i]);
        i++;
      }
      i--;
      Wire.endTransmission();
    }      
    #else
    for (uint16_t i=0; i<(128*64/8); i++) 
    {
      // send a bunch of data in one xmission
      Wire.beginTransmission(SlaveAddress);
      Wire.send(GOFi2cOLED_Data_Mode);            // data mode
      for (uint8_t x=0; x<16; x++) 
      {
        Wire.send(buffer[i]);
        i++;
      }  
      i--;
      Wire.endTransmission();
    }
    #endif    
//    TWBR = twbrbackup;
}

void GOFi2cOLED::clearDisplay()
{
  memset(buffer, 0, (128*64/8));
}

void GOFi2cOLED::clearArea(uint8_t x, uint8_t y, uint8_t w, uint8_t h)
{
	fillRect(x, y, w, h, BLACK);
}


void GOFi2cOLED::drawBitmap(uint8_t x, uint8_t y, 
			      const uint8_t *bitmap, uint8_t w, uint8_t h,
			      uint8_t color) {
  for (uint8_t j=0; j<h; j++) {
    for (uint8_t i=0; i<w; i++ ) {
      if (pgm_read_byte(bitmap + i + (j/8)*w) & _BV(j%8)) {
	drawPixel(x+i, y+j, color);
      }
    }
  }
}

// draw a character
void GOFi2cOLED::drawChar(int8_t x, int8_t y, unsigned char c, int8_t color, int8_t bg, uint8_t size) {

  if((x >= _width)            || // Clip right
     (y >= _height)           || // Clip bottom
     ((x + 5 * size - 1) < 0) || // Clip left
     ((y + 8 * size - 1) < 0))   // Clip top
    return;

  for (int8_t i=0; i<6; i++ ) {
    uint8_t line;
    if (i == 5) 
      line = 0x0;
    else 
      line = pgm_read_byte(BasicFont+(c*5)+i);
    for (int8_t j = 0; j<8; j++) {
      if (line & 0x1) {
        if (size == 1) // default size
          drawPixel(x+i, y+j, color);
        else {  // big size
          fillRect(x+(i*size), y+(j*size), size, size, color);
        } 
      } else if (bg != color) {
        if (size == 1) // default size
          drawPixel(x+i, y+j, bg);
        else {  // big size
          fillRect(x+i*size, y+j*size, size, size, bg);
        } 	
      }
      line >>= 1;
    }
  }
}

void GOFi2cOLED::setTextSize(uint8_t s) {
  textsize = (s > 0) ? s : 1;
}

void GOFi2cOLED::setCursor(uint8_t x, uint8_t y) {
  cursor_x = x;
  cursor_y = y;
}

void GOFi2cOLED::setTextColor(uint8_t c) {
  textcolor = c;
  textbgcolor = c; 
  // for 'transparent' background, we'll set the bg 
  // to the same as fg instead of using a flag
}

 void GOFi2cOLED::setTextColor(uint8_t c, uint8_t b) {
   textcolor = c;
   textbgcolor = b; 
 }

void GOFi2cOLED::setTextWrap(boolean w) {
  wrap = w;
}

// draw a rectangle
void GOFi2cOLED::drawRect(uint8_t x, uint8_t y, 
			    uint8_t w, uint8_t h, 
			    uint8_t color) {
  drawFastHLine(x, y, w, color);
  drawFastHLine(x, y+h-1, w, color);
  drawFastVLine(x, y, h, color);
  drawFastVLine(x+w-1, y, h, color);
}

void GOFi2cOLED::fillRect(uint8_t x, uint8_t y, uint8_t w, uint8_t h, 
			    uint8_t color) {
  // stupidest version - update in subclasses if desired!
  for (uint8_t i=x; i<x+w; i++) {
    drawFastVLine(i, y, h, color); 
  }
}

void GOFi2cOLED::drawFastVLine(uint8_t x, uint8_t y, 
				 uint8_t h, uint8_t color) {
  // stupidest version - update in subclasses if desired!
  drawLine(x, y, x, y+h-1, color);
}

void GOFi2cOLED::drawFastHLine(uint8_t x, uint8_t y, 
				 uint8_t w, uint8_t color) {
  // stupidest version - update in subclasses if desired!
  drawLine(x, y, x+w-1, y, color);
}

// bresenham's algorithm - thx wikpedia
void GOFi2cOLED::drawLine(uint8_t x0, uint8_t y0, 
			    uint8_t x1, uint8_t y1, 
			    uint8_t color) {
  int16_t steep = abs(y1 - y0) > abs(x1 - x0);
  if (steep) {
    swap(x0, y0);
    swap(x1, y1);
  }

  if (x0 > x1) {
    swap(x0, x1);
    swap(y0, y1);
  }

  int16_t dx, dy;
  dx = x1 - x0;
  dy = abs(y1 - y0);

  int16_t err = dx / 2;
  int16_t ystep;

  if (y0 < y1) {
    ystep = 1;
  } else {
    ystep = -1;
  }

  for (; x0<=x1; x0++) {
    if (steep) {
      drawPixel(y0, x0, color);
    } else {
      drawPixel(x0, y0, color);
    }
    err -= dy;
    if (err < 0) {
      y0 += ystep;
      err += dx;
    }
  }
}

// draw a rounded rectangle!
void GOFi2cOLED::drawRoundRect(uint8_t x, uint8_t y, uint8_t w, uint8_t h, uint8_t r, uint8_t color) {
  // smarter version
  drawFastHLine(x+r  , y    , w-2*r, color); // Top
  drawFastHLine(x+r  , y+h-1, w-2*r, color); // Bottom
  drawFastVLine(  x    , y+r  , h-2*r, color); // Left
  drawFastVLine(  x+w-1, y+r  , h-2*r, color); // Right
  // draw four corners
  drawCircleHelper(x+r    , y+r    , r, 1, color);
  drawCircleHelper(x+w-r-1, y+r    , r, 2, color);
  drawCircleHelper(x+w-r-1, y+h-r-1, r, 4, color);
  drawCircleHelper(x+r    , y+h-r-1, r, 8, color);
}

// fill a rounded rectangle!
void GOFi2cOLED::fillRoundRect(uint8_t x, uint8_t y, uint8_t w, uint8_t h, uint8_t r, uint8_t color) {
  // smarter version
  fillRect(x+r, y, w-2*r, h, color);

  // draw four corners
  fillCircleHelper(x+w-r-1, y+r, r, 1, h-2*r-1, color);
  fillCircleHelper(x+r    , y+r, r, 2, h-2*r-1, color);
}


// draw a triangle!
void GOFi2cOLED::drawTriangle(uint8_t x0, uint8_t y0,
				uint8_t x1, uint8_t y1, 
				uint8_t x2, uint8_t y2, uint8_t color) {
  drawLine(x0, y0, x1, y1, color);
  drawLine(x1, y1, x2, y2, color);
  drawLine(x2, y2, x0, y0, color);
}

// fill a triangle!
void GOFi2cOLED::fillTriangle (uint8_t x0, uint8_t y0,
				uint8_t x1, uint8_t y1, 
				uint8_t x2, uint8_t y2, uint8_t color) {

  int16_t a, b, y, last;

  // Sort coordinates by Y order (y2 >= y1 >= y0)
  if (y0 > y1) {
    swap(y0, y1); swap(x0, x1);
  }
  if (y1 > y2) {
    swap(y2, y1); swap(x2, x1);
  }
  if (y0 > y1) {
    swap(y0, y1); swap(x0, x1);
  }

  if(y0 == y2) { // Handle awkward all-on-same-line case as its own thing
    a = b = x0;
    if(x1 < a)      a = x1;
    else if(x1 > b) b = x1;
    if(x2 < a)      a = x2;
    else if(x2 > b) b = x2;
    drawFastHLine(a, y0, b-a+1, color);
    return;
  }

  int16_t
    dx01 = x1 - x0,
    dy01 = y1 - y0,
    dx02 = x2 - x0,
    dy02 = y2 - y0,
    dx12 = x2 - x1,
    dy12 = y2 - y1,
    sa   = 0,
    sb   = 0;

  // For upper part of triangle, find scanline crossings for segments
  // 0-1 and 0-2.  If y1=y2 (flat-bottomed triangle), the scanline y1
  // is included here (and second loop will be skipped, avoiding a /0
  // error there), otherwise scanline y1 is skipped here and handled
  // in the second loop...which also avoids a /0 error here if y0=y1
  // (flat-topped triangle).
  if(y1 == y2) last = y1;   // Include y1 scanline
  else         last = y1-1; // Skip it

  for(y=y0; y<=last; y++) {
    a   = x0 + sa / dy01;
    b   = x0 + sb / dy02;
    sa += dx01;
    sb += dx02;
    /* longhand:
    a = x0 + (x1 - x0) * (y - y0) / (y1 - y0);
    b = x0 + (x2 - x0) * (y - y0) / (y2 - y0);
    */
    if(a > b) swap(a,b);
    drawFastHLine(a, y, b-a+1, color);
  }

  // For lower part of triangle, find scanline crossings for segments
  // 0-2 and 1-2.  This loop is skipped if y1=y2.
  sa = dx12 * (y - y1);
  sb = dx02 * (y - y0);
  for(; y<=y2; y++) {
    a   = x1 + sa / dy12;
    b   = x0 + sb / dy02;
    sa += dx12;
    sb += dx02;
    /* longhand:
    a = x1 + (x2 - x1) * (y - y1) / (y2 - y1);
    b = x0 + (x2 - x0) * (y - y0) / (y2 - y0);
    */
    if(a > b) swap(a,b);
    drawFastHLine(a, y, b-a+1, color);
  }
}

// draw a circle outline
void GOFi2cOLED::drawCircle(uint8_t x0, uint8_t y0, uint8_t r, 
			      uint8_t color) {
  int16_t f = 1 - r;
  int16_t ddF_x = 1;
  int16_t ddF_y = -2 * r;
  int16_t x = 0;
  int16_t y = r;

  drawPixel(x0, y0+r, color);
  drawPixel(x0, y0-r, color);
  drawPixel(x0+r, y0, color);
  drawPixel(x0-r, y0, color);

  while (x<y) {
    if (f >= 0) {
      y--;
      ddF_y += 2;
      f += ddF_y;
    }
    x++;
    ddF_x += 2;
    f += ddF_x;
  
    drawPixel(x0 + x, y0 + y, color);
    drawPixel(x0 - x, y0 + y, color);
    drawPixel(x0 + x, y0 - y, color);
    drawPixel(x0 - x, y0 - y, color);
    drawPixel(x0 + y, y0 + x, color);
    drawPixel(x0 - y, y0 + x, color);
    drawPixel(x0 + y, y0 - x, color);
    drawPixel(x0 - y, y0 - x, color);
    
  }
}

void GOFi2cOLED::drawCircleHelper( uint8_t x0, uint8_t y0,
               uint8_t r, uint8_t cornername, uint8_t color) {
  int16_t f     = 1 - r;
  int16_t ddF_x = 1;
  int16_t ddF_y = -2 * r;
  int16_t x     = 0;
  int16_t y     = r;

  while (x<y) {
    if (f >= 0) {
      y--;
      ddF_y += 2;
      f     += ddF_y;
    }
    x++;
    ddF_x += 2;
    f     += ddF_x;
    if (cornername & 0x4) {
      drawPixel(x0 + x, y0 + y, color);
      drawPixel(x0 + y, y0 + x, color);
    } 
    if (cornername & 0x2) {
      drawPixel(x0 + x, y0 - y, color);
      drawPixel(x0 + y, y0 - x, color);
    }
    if (cornername & 0x8) {
      drawPixel(x0 - y, y0 + x, color);
      drawPixel(x0 - x, y0 + y, color);
    }
    if (cornername & 0x1) {
      drawPixel(x0 - y, y0 - x, color);
      drawPixel(x0 - x, y0 - y, color);
    }
  }
}

void GOFi2cOLED::fillCircle(uint8_t x0, uint8_t y0, uint8_t r, 
			      uint8_t color) {
  drawFastVLine(x0, y0-r, 2*r+1, color);
  fillCircleHelper(x0, y0, r, 3, 0, color);
}

// used to do circles and roundrects!
void GOFi2cOLED::fillCircleHelper(uint8_t x0, uint8_t y0, uint8_t r,
				    uint8_t cornername, int16_t delta, uint8_t color) {

  int16_t f     = 1 - r;
  int16_t ddF_x = 1;
  int16_t ddF_y = -2 * r;
  int16_t x     = 0;
  int16_t y     = r;

  while (x<y) {
    if (f >= 0) {
      y--;
      ddF_y += 2;
      f     += ddF_y;
    }
    x++;
    ddF_x += 2;
    f     += ddF_x;

    if (cornername & 0x1) {
      drawFastVLine(x0+x, y0-y, 2*y+1+delta, color);
      drawFastVLine(x0+y, y0-x, 2*x+1+delta, color);
    }
    if (cornername & 0x2) {
      drawFastVLine(x0-x, y0-y, 2*y+1+delta, color);
      drawFastVLine(x0-y, y0-x, 2*x+1+delta, color);
    }
  }
}

void GOFi2cOLED::setHorizontalScrollProperties(bool direction,unsigned char startPage, unsigned char endPage, unsigned char scrollSpeed)
{
/*
Use the following defines for 'direction' :

 Scroll_Left			
 Scroll_Right			

Use the following defines for 'scrollSpeed' :

 Scroll_2Frames		
 Scroll_3Frames
 Scroll_4Frames
 Scroll_5Frames	
 Scroll_25Frames
 Scroll_64Frames
 Scroll_128Frames
 Scroll_256Frames

*/

   if(Scroll_Right == direction)
   {
    //Scroll Right
    sendCommand(Right_Horizontal_Scroll_Cmd);
   }
   else
   {
    //Scroll Left  
    sendCommand(Left_Horizontal_Scroll_Cmd);

   }
    sendCommand(Dummy_Byte_0x00);//Dummy byte
    sendCommand(startPage);
    sendCommand(scrollSpeed);
    sendCommand(endPage);
    sendCommand(Dummy_Byte_0x00);//Dummy byte
    sendCommand(Dummy_Byte_0xFF);//Dummy byte
}

void GOFi2cOLED::activateScroll()
{
    sendCommand(Activate_Scroll_Cmd);
}

void GOFi2cOLED::deactivateScroll()
{
    sendCommand(Deactivate_Scroll_Cmd);
}

void GOFi2cOLED::setNormalDisplay()
{
    sendCommand(GOFi2cOLED_Normal_Display_Cmd);
}

void GOFi2cOLED::setInverseDisplay()
{
    sendCommand(GOFi2cOLED_Inverse_Display_Cmd);
}

void GOFi2cOLED::setRotation(uint8_t x) {
  x %= 4;  // cant be higher than 3
  rotation = x;
  switch (x) {
  case 0:
  case 2:
    _width = WIDTH;
    _height = HEIGHT;
    break;
  case 1:
  case 3:
    _width = HEIGHT;
    _height = WIDTH;
    break;
  }
}

uint8_t GOFi2cOLED::getRotation(void) {
  rotation %= 4;
  return rotation;
}

// return the size of the display which depends on the rotation!
uint8_t GOFi2cOLED::width(void) { 
  return _width; 
}
 
uint8_t GOFi2cOLED::height(void) { 
  return _height; 
}

#if ARDUINO >= 100
size_t GOFi2cOLED::write(uint8_t c) {
#else
void GOFi2cOLED::write(uint8_t c) {
#endif
   if (c == '\n') {
    cursor_y += textsize*8;
    cursor_x = 0;
  } else if (c == '\r') {
    // skip em
  } else {
    drawChar(cursor_x, cursor_y, c, textcolor, textbgcolor, textsize);
    cursor_x += textsize*6;
    if (wrap && (cursor_x > (_width - textsize*6))) {
      cursor_y += textsize*8;
      cursor_x = 0;

    }
  }
/*    if(C < 32 || C > 127) //Ignore non-printable ASCII characters. This can be modified for multilingual font.
    {
    C=' '; //Space
    }	
    unsigned char i=0;
    for(i=0;i<8;i++)
    {
       //read bytes from code memory
       sendData(pgm_read_byte(&BasicFont[C-32][i])); //font array starts at 0, ASCII starts at 32. Hence the translation
    }

*/

#if ARDUINO >= 100
  return 1;
#endif
}

//GOFi2cOLED GOFi2cOLED;  // Preinstantiate Objects

